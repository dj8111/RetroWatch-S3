## firmware/sdkconfig.defaults
```kconfig
# ESP32-S3 CPU & Frequency
CONFIG_IDF_TARGET="esp32s3"
CONFIG_ESP32S3_DEFAULT_CPU_FREQ_240=y
CONFIG_ESP32S3_DEFAULT_CPU_FREQ_MHZ=240

# Flash 16MB 配置
CONFIG_ESPTOOLPY_FLASHSIZE_16MB=y
CONFIG_PARTITION_TABLE_CUSTOM=y
CONFIG_PARTITION_TABLE_CUSTOM_FILENAME="partitions.csv"

# PSRAM 8MB Octal 配置 (高速相機與遊戲必備)
CONFIG_SPIRAM=y
CONFIG_SPIRAM_MODE_OCT=y
CONFIG_SPIRAM_TYPE_AUTO=y
CONFIG_SPIRAM_SPEED_80M=y
CONFIG_SPIRAM_BOOT_INIT=y
CONFIG_SPIRAM_USE_MALLOC=y

# FreeRTOS 效能設定
CONFIG_FREERTOS_HZ=1000
CONFIG_FREERTOS_CORE_AFFINITY_AUTOMATIC=y

# Compiler Optimization
CONFIG_COMPILER_OPTIMIZATION_PERF=y
```
